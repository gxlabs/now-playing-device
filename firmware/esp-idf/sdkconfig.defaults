## firmware/esp-idf/sdkconfig.defaults
```kconfig
# Target
CONFIG_IDF_TARGET="esp32c6"

# Flash / partitions
CONFIG_ESPTOOLPY_FLASHSIZE_4MB=y
CONFIG_PARTITION_TABLE_CUSTOM=y
CONFIG_PARTITION_TABLE_CUSTOM_FILENAME="partitions.csv"

# Primary console on UART0 (no pin attached); USB-Serial-JTAG mirrors logs +
# panic output so they come through USB-CDC alongside the binary data protocol.
# The host's read_commands strips non-CMD lines as [RX].
CONFIG_ESP_CONSOLE_UART_DEFAULT=y
CONFIG_ESP_CONSOLE_SECONDARY_USB_SERIAL_JTAG=y

# LVGL: disable built-in Montserrat fonts (ASCII-only). We ship custom
# montserrat_ext_* in main/fonts/ that cover Latin-1 Supplement +
# Extended-A, so accented track/artist names render. Keep _14 enabled
# only because LVGL needs a built-in default font.
CONFIG_LV_FONT_MONTSERRAT_14=y

# LVGL QR code
CONFIG_LV_USE_QRCODE=y

# FreeRTOS
CONFIG_FREERTOS_HZ=1000
```
